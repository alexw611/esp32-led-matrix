// content6.h  
// Bitmap lokal auf ESP32 / im Code


#ifndef CONTENT6_H
#define CONTENT6_H
#include <ESP32-HUB75-MatrixPanel-I2S-DMA.h>

const uint16_t epd_bitmap_pxArt[128 * 64] PROGMEM = {

0x0884, 0x0884, 0x0064, 0x0064, 0x0064, 0x0064, 0x10e5, 0x10c5, 0x0084, 0x0064, 0x0064, 0x0064, 0x0064, 0x0064, 0x0064, 0x0064, 
	0x0064, 0x0064, 0x0064, 0x0064, 0x0064, 0x0064, 0x0084, 0x0064, 0x0064, 0x0064, 0x0064, 0x0064, 0x0064, 0x0064, 0x0064, 0x0064, 
	0x0064, 0x0064, 0x0064, 0x0064, 0x0064, 0x0064, 0x2126, 0x2966, 0x0064, 0x0064, 0x0064, 0x0064, 0x0064, 0x0064, 0x0064, 0x0064, 
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	0x0086, 0x0085, 0x0085, 0x0085, 0x0085, 0x0085, 0x0865, 0x0865, 0x0865, 0x0864, 0x0864, 0x0864, 0x0864, 0x0864, 0x0844, 0x0864
};

#define IMG6_WIDTH 128
#define IMG6_HEIGHT 64

// Statische Variablen für Status-Tracking
static bool content6_displayed = false;
static MatrixPanel_I2S_DMA* last_display = nullptr;
static uint32_t last_call_time = 0;
static const uint32_t REFRESH_TIMEOUT = 1000; // 1 Sekunde timeout

void showContent6(MatrixPanel_I2S_DMA* display) {
  uint32_t current_time = millis();
  
  // Automatisches Refresh nach Timeout oder bei Display-Wechsel
  bool needs_refresh = false;
  if (!content6_displayed || last_display != display) {
    // Erstes Mal oder Display-Wechsel
    needs_refresh = true;
  } else if (current_time - last_call_time > REFRESH_TIMEOUT) {
    // Timeout erreicht - vermutlich wurde zwischenzeitlich was anderes angezeigt
    needs_refresh = true;
  }
  
  if (needs_refresh) {
    display->clearScreen();
    
    // Bild mittig platzieren
    int x0 = (display->width() - IMG6_WIDTH) / 2;
    int y0 = (display->height() - IMG6_HEIGHT) / 2;
    
    // Optimierte Pixel-Schreibung mit PROGMEM-Zugriff
    for (int y = 0; y < IMG6_HEIGHT; y++) {
      for (int x = 0; x < IMG6_WIDTH; x++) {
        // Korrekter PROGMEM-Zugriff für ESP32
        uint16_t color = pgm_read_word(&epd_bitmap_pxArt[y * IMG6_WIDTH + x]);
        display->drawPixel(x0 + x, y0 + y, color);
      }
    }
    
    // Status aktualisieren
    content6_displayed = true;
    last_display = display;
  }
  
  // Zeit des letzten Aufrufs speichern
  last_call_time = current_time;
}

// Optional: Funktion zum manuellen Reset
void forceContent6Refresh() {
  content6_displayed = false;
  last_display = nullptr;
  last_call_time = 0;
}

#endif